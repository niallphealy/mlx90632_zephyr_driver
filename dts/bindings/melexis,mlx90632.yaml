## dts/bindings/melexis,mlx90632.yaml
```yaml
description: MLX90632 infrared temperature sensor

compatible: "melexis,mlx90632"

include: [sensor-device.yaml, i2c-device.yaml]
```

## sensor/mlx90632/Kconfig
```kconfig
# Configuration options

config MLX90632
	bool "MLX90632 Driver"
	default y
	select I2C
	help
	  Enable the driver for the Melexis MLX90632 infrared temperature sensor
```
